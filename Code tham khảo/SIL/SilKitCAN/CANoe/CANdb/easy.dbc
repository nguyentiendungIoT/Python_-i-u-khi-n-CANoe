VERSION "DNNBNNNYNNNNNNNNNNNNNNNNNNYYYNNNNNNNNNNNNN/4/%%%/4/'%**4NNN///"

NS_ :

BS_:

BU_: Control Display

BO_ 118 LightControl: 1 Control
 SG_ HeadLightControl : 1|1@1+ (1,0) [0|0] "" Vector__XXX
 SG_ FlashLightControl : 0|1@1+ (1,0) [0|0] "" Vector__XXX

BO_ 103 IgnitionInfo: 1 Control
 SG_ OnOff : 0|1@1+ (1,0) [0|0] "" Vector__XXX

BO_ 291 EngineState: 2 Control
 SG_ EngineSpeed : 0|16@1- (1,0) [0|0] "rpm"  Display

BO_ 801 LightState: 1 Control
 SG_ FlashLight : 0|1@1+ (1,0) [0|1] ""  Display
 SG_ HeadLight : 1|1@1+ (1,0) [0|1] ""  Display

BA_DEF_ BU_  "ILUsed" ENUM  "Yes","No";
BA_DEF_ SG_  "GenSigSendType" ENUM  "Cyclic","OnWrite","OnWriteWithRepetition","OnChange","OnChangeWithRepetition","IfActive","IfActiveWithRepetition";
BA_DEF_ BO_  "GenMsgDelayTime" INT 1 1000;
BA_DEF_ BO_  "GenMsgCycleTime" INT 2 50000;
BA_DEF_ BO_  "GenMsgCycleTimeFast" INT 2 100000;
BA_DEF_ BO_  "GenMsgILSupport" ENUM  "No","Yes";
BA_DEF_ BU_  "NodeLayerModules" STRING ;
BA_DEF_DEF_  "ILUsed" "Yes";
BA_DEF_DEF_  "GenSigSendType" "Cyclic";
BA_DEF_DEF_  "GenMsgDelayTime" 1;
BA_DEF_DEF_  "GenMsgCycleTime" 2;
BA_DEF_DEF_  "GenMsgCycleTimeFast" 100;
BA_DEF_DEF_  "GenMsgILSupport" "Yes";
BA_DEF_DEF_  "NodeLayerModules" "CANoeILNLVector.dll";
BA_ "GenMsgCycleTime" BO_ 291 100;
BA_ "GenMsgCycleTime" BO_ 801 100;
BA_ "GenSigSendType" SG_ 801 HeadLight 3;
VAL_ 118 HeadLightControl 1 "On" 0 "Off" ;
VAL_ 118 FlashLightControl 1 "On" 0 "Off" ;
VAL_ 103 OnOff 1 "On" 0 "Off" ;
