/*@!Encoding:1252*/
variables 
{
  int gFlashLightsStatus = 0;
  int gHeadLightsStatus = 0;

  int gDebugCounterTX = 0;
  int gDebugCounterTXRQ = 0;
  int gDebugCounterRX = 0;
}

on start
{
   setWriteDbgLevel(0); // set DbgLevel = 1 to get more information in Write-Window
}

on key '0'
{
  setwriteDbgLevel(0);
}

on key '1'
{
  setwriteDbgLevel(1);
}

on sysvar sysvar::Lights::HazardLightsSwitch
{
  if (@this)
  {
    gFlashLightsStatus = 1;
  }
  else
  {
    gFlashLightsStatus = 0;
  }

  $LightControl::FlashLightControl = gFlashLightsStatus;
}


on sysvar sysvar::Lights::HeadLightsSwitch
{
  if (@this)
  {
    gHeadLightsStatus = 1;
  }
  else
  {
    gHeadLightsStatus = 0;
  }

  $LightControl::HeadLightControl = gHeadLightsStatus;
}

on sysvar sysvar::Engine::EngineStateSwitch
{
  $IgnitionInfo::OnOff = @this;
}

on sysvar sysvar::Engine::EngineSpeedEntry
{
  if(@sysvar::Engine::EngineStateSwitch) 
  {
    $EngineState::EngineSpeed = @this;
  }
}
