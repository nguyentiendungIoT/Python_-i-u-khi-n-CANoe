/*@!Encoding:1252*/
includes
{
  
}

variables
{
  const long maxMsgSize = 100000000; 
  byte buffer[maxMsgSize];
  long i = 0; 
}

// ping-pong mechanism 
on value_update PerformanceMeasurement::PingPong.Ping
{ 
  sendData();
}  

on start
{
  write("Starting Ping-Pong between SUT and CANoe.");
  
  // initialize buffer
  for (i = 0; i < maxMsgSize; i++)
  {
    buffer[i] = 42; // random choice, could be any other integer    
  }

  $PerformanceMeasurement::MeasurementState.IsMeasurementRunning = 1;
}

on stopMeasurement
{
  $PerformanceMeasurement::MeasurementState.IsMeasurementRunning = 0;
}

void sendData()
{
  // range check  
  if( $PerformanceMeasurement::MsgSize.Value < 1 ) {
    write("Invalid message size!");
    stop();
  }
  
  // send pong  
  memcpy($PerformanceMeasurement::PingPong.Pong, buffer, $PerformanceMeasurement::MsgSize.Value);
}